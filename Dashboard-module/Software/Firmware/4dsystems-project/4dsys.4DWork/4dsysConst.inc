// File generated 14 apr. 2024 14:30:49
// Warning! This is a generated file, any manual changes will be
// lost during the next generation.

#constant  IFONT_OFFSET     0
// object indexes into FlashBank Functions
#CONST
    Fgfx_Button5                1
    Fgfx_Label2                 2  // Genie, double byte string from RAM
    Fgfx_MediaButton            3
    Fgfx_MediaGauge             4
    Fgfx_MediaPanel             5
    Fgfx_MediaRotary            6
    Fgfx_MediaSlider            7
    Fgfx_MediaThermometer       8
    Fgfx_Slider3                9
    Fgfx_Slider4                10
    Fgfx_Slider6                11
    Fgfx_Slider7                12
    Fgfx_Slider8                13
    Fgfx_Switch2                14
#END
// object indexes into WIDGET pointer
#CONST
    iIGauge0
    iIMediaLed0
    iIGauge1
    iIGauge2
    iIMediaLed1
    iIMediaLed2
    iIMediaLed3
#END

// object indexes into ImageControl
#CONST
    iLeddigits1     // offset 0x0
    iiLeddigits1    // offset 0x6800
    iStatictext0    // offset 0x13A00
    iStatictext1    // offset 0x14400
    iStatictext3    // offset 0x15600
    iStatictext22   // offset 0x16000
    iStatictext23   // offset 0x16400
    iStatictext2    // offset 0x16800
    iStatictext24   // offset 0x18000
    iStatictext25   // offset 0x18A00
    iStatictext26   // offset 0x19000
    iLeddigits0     // offset 0x19600
    iiLeddigits0    // offset 0x25200
    iLeddigits5     // offset 0x9A600
    iiLeddigits5    // offset 0x9E600
    iLeddigits6     // offset 0xABC00
    iiLeddigits6    // offset 0xAFC00
    iLeddigits7     // offset 0xBD200
    iiLeddigits7    // offset 0xC1400
    iLeddigits8     // offset 0xCEE00
    iiLeddigits8    // offset 0xD2E00
    iLeddigits9     // offset 0xE0400
    iiLeddigits9    // offset 0xE4400
    iLeddigits10    // offset 0xF1A00
    iiLeddigits10   // offset 0xF5A00
    iStatictext4    // offset 0x103000
    iStatictext5    // offset 0x104000
    iStatictext6    // offset 0x105200
    iStatictext7    // offset 0x106800
    iStatictext8    // offset 0x107A00
    iStatictext9    // offset 0x108A00
    iStatictext10   // offset 0x10A600
    iStatictext11   // offset 0x10AE00
    iStatictext12   // offset 0x10C600
    iLeddigits2     // offset 0x10D800
    iiLeddigits2    // offset 0x111800
    iLeddigits3     // offset 0x11EE00
    iiLeddigits3    // offset 0x122E00
    iStatictext13   // offset 0x130400
    iStatictext14   // offset 0x130C00
    iLeddigits4     // offset 0x131200
    iiLeddigits4    // offset 0x135200
    iLeddigits11    // offset 0x142800
    iiLeddigits11   // offset 0x146800
    iLeddigits12    // offset 0x153E00
    iiLeddigits12   // offset 0x157E00
    iLeddigits13    // offset 0x165400
    iiLeddigits13   // offset 0x169400
    iLeddigits14    // offset 0x176A00
    iiLeddigits14   // offset 0x17AA00
    iStatictext16   // offset 0x188000
    iStatictext17   // offset 0x188800
    iStatictext18   // offset 0x189000
    iStatictext19   // offset 0x189800
    iLeddigits15    // offset 0x18A000
    iiLeddigits15   // offset 0x18E000
    iStatictext20   // offset 0x19B600
    iLeddigits16    // offset 0x19CA00
    iiLeddigits16   // offset 0x1A0A00
    iStatictext21   // offset 0x1AE000
    iStatictext15   // offset 0x1AF200
    iImage0         // offset 0x1B0E00
    iLeddigits17    // offset 0x1EEE00
    iiLeddigits17   // offset 0x1F3A00
    iLeddigits18    // offset 0x203600
    iiLeddigits18   // offset 0x208000
    iLeddigits19    // offset 0x217A00
    iiLeddigits19   // offset 0x21CC00
    iLeddigits20    // offset 0x22DC00
    iiLeddigits20   // offset 0x232800
    iStatictext27   // offset 0x242600
    iStatictext28   // offset 0x243C00
    iStatictext31   // offset 0x245600
    iStatictext29   // offset 0x246C00
    iImage1         // offset 0x248E00
#END



#IFNOT EXISTS NOGLOBALS
var hndl ;
#ENDIF
